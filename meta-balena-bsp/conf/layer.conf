## meta-balena-bsp/conf/layer.conf
```bitbake
BBPATH .= ":${LAYERDIR}"

BBFILES += "${LAYERDIR}/recipes-*/*/*.bb \
            ${LAYERDIR}/recipes-*/*/*.bbappend"

BBFILE_COLLECTIONS += "balena-bsp"
BBFILE_PATTERN_balena-bsp := "^${LAYERDIR}/"
BBFILE_PRIORITY_balena-bsp = "1337"

LAYERSERIES_COMPAT_balena-bsp = "pyro rocko sumo thud warrior"

BALENA_DEPRECATED_YOCTO_LAYER ?= "0"

RESIN_COREBASE := '${@os.path.normpath("${LAYERDIR}/")}'

IMAGE_ROOTFS_SIZE ?= "0"
```
